## main/Kconfig.projbuild
```kconfig
menu "WeClawBot"

config WEC_WIFI_SSID
    string "Wi-Fi SSID"
    default ""
    help
        Wi-Fi SSID for the bot. Use menuconfig or sdkconfig.defaults.local.

config WEC_WIFI_PASSWORD
    string "Wi-Fi password"
    default ""
    help
        Wi-Fi password for the bot.

config WEC_WECHAT_BASE_URL
    string "WeChat ilink base URL"
    default "https://ilinkai.weixin.qq.com"

config WEC_CURATOR_URL
    string "WeClawBot curator HTTP URL"
    default "https://weclawbot.link/api/curator"
    help
        Optional HTTP endpoint for the Curator Skill Runtime. When empty, text
        messages are stored locally without cloud curation.

config WEC_POLL_INTERVAL_MS
    int "WeChat getupdates poll interval"
    default 800
    range 300 10000

config WEC_MAX_NOTES
    int "Maximum local sticky notes"
    default 12
    range 1 30

config WEC_MAX_NOTE_BYTES
    int "Maximum UTF-8 bytes per sticky note"
    default 720
    range 120 3000

config WEC_SCREENSAVER_IDLE_SEC
    int "Idle seconds before screensaver"
    default 600
    range 30 86400

config WEC_SCREENSAVER_RETURN_SEC
    int "Seconds to show screensaver before returning to notes"
    default 20
    range 5 300

config WEC_AUTO_PAGE_SEC
    int "Seconds between automatic desktop carousel transitions"
    default 12
    range 10 3600
    help
        The connected desktop rotates calendar, black-and-white photo frame,
        and the current sticky note. Multi-page notes advance one page at a
        time during their turn. Manual buttons remain available as emergency
        controls but should not be part of normal use.

config WEC_PLATFORM_HINT
    string "Platform service hint for non-text messages"
    default "文档、图片和其他文件需要开通 WeClawBot 平台服务"

config WEC_REPLY_ON_TEXT
    bool "Reply to WeChat when a text note is posted"
    default n

config WEC_DEVELOPMENT_BUILD
    bool "Mark firmware as a local development build"
    default n
    help
        Show the development label on the device header. Public firmware
        releases should keep this disabled.

config WEC_PRODUCT_DISK
    bool "Expose WeClawBot USB product disk"
    default n
    help
        Enable the TinyUSB MSC product disk used by release builds to expose
        help files and website links. Keep this disabled for development builds
        so USB-Serial-JTAG remains available for flashing and live logs.

config WEC_BATTERY_INSTALLED
    bool "Device has an installed 18650 battery"
    default n
    help
        BAT_ADC reads the board power path through a divider. On USB power it
        can still report a lithium-like voltage even when no 18650 cell is
        installed, so keep this disabled for boards running without a battery.

endmenu
```

## sdkconfig.defaults
```kconfig
CONFIG_IDF_TARGET="esp32s3"
CONFIG_ESPTOOLPY_FLASHSIZE_16MB=y
CONFIG_PARTITION_TABLE_CUSTOM=y
CONFIG_PARTITION_TABLE_CUSTOM_FILENAME="partitions.csv"
CONFIG_PARTITION_TABLE_FILENAME="partitions.csv"
CONFIG_COMPILER_CXX_EXCEPTIONS=n
CONFIG_COMPILER_CXX_RTTI=n
CONFIG_SPIRAM=y
CONFIG_SPIRAM_MODE_OCT=y
CONFIG_SPIRAM_SPEED_80M=y
CONFIG_SPIRAM_MALLOC_ALWAYSINTERNAL=32768
CONFIG_SPIRAM_TRY_ALLOCATE_WIFI_LWIP=y
CONFIG_ESP_SYSTEM_EVENT_TASK_STACK_SIZE=4096
CONFIG_ESP_TLS_USE_SECURE_ELEMENT=n
CONFIG_MBEDTLS_EXTERNAL_MEM_ALLOC=y
CONFIG_MBEDTLS_DYNAMIC_BUFFER=y
CONFIG_MBEDTLS_DYNAMIC_FREE_CONFIG_DATA=y
CONFIG_MBEDTLS_DYNAMIC_FREE_CA_CERT=y
CONFIG_MBEDTLS_CERTIFICATE_BUNDLE=y
CONFIG_MBEDTLS_CERTIFICATE_BUNDLE_DEFAULT_FULL=y
CONFIG_ESP_HTTP_CLIENT_ENABLE_HTTPS=y
CONFIG_LWIP_SNTP_UPDATE_DELAY=3600000
CONFIG_LV_COLOR_DEPTH_16=y
CONFIG_LV_FONT_MONTSERRAT_14=y
CONFIG_LV_FONT_FMT_TXT_LARGE=y
CONFIG_LV_USE_LABEL=y
CONFIG_LV_USE_IMAGE=y
CONFIG_LV_USE_IMGFONT=y
CONFIG_USJ_ENABLE_USB_SERIAL_JTAG=y
# CONFIG_ESP_CONSOLE_SECONDARY_NONE is not set
CONFIG_ESP_CONSOLE_SECONDARY_USB_SERIAL_JTAG=y
# CONFIG_WEC_PRODUCT_DISK is not set
CONFIG_WEC_CURATOR_URL="https://weclawbot.link/api/curator"

# CONFIG_WEC_DEVELOPMENT_BUILD is not set
```
